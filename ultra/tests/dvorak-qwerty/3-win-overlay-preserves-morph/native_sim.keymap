#include <dt-bindings/zmk/keys.h>
#include <behaviors.dtsi>
#include <dt-bindings/zmk/kscan_mock.h>
#include "../behavior_overlay.dtsi"

&kscan {
    events = <
        /* 1) Hold the "slide switch" -> WIN_DWERTY base (layer 1) becomes active */
        ZMK_MOCK_PRESS(1,0,10)
        /* 2) Overlay active: Ctrl + morph key -> still Qwerty Ctrl+C (0x01 + 0x06).
         *    This is the regression guard: a full Win base must NOT block
         *    the morph on the layer below. */
        ZMK_MOCK_PRESS(0,1,10)
        ZMK_MOCK_PRESS(0,0,10)
        ZMK_MOCK_RELEASE(0,0,10)
        ZMK_MOCK_RELEASE(0,1,10)
        /* 3) Overlay active: the modifier position is swapped LALT -> LGUI
         *    (0xE3), proving the overlay really is on during step 2. */
        ZMK_MOCK_PRESS(1,1,10)
        ZMK_MOCK_RELEASE(1,1,10)
        /* 4) Release the slide switch, then tap the morph alone -> plain
         *    Dvorak J (0x0D): overlay gone, typing layer unchanged. */
        ZMK_MOCK_RELEASE(1,0,10)
        ZMK_MOCK_PRESS(0,0,10)
        ZMK_MOCK_RELEASE(0,0,10)
    >;
};
